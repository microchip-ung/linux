/*
 * Copyright (C) 2018 Microsemi Inc.
 *
 * This program is free software; you can redistribute it and/or modify
 * it under the terms of the GNU General Public License version 2 as
 * published by the Free Software Foundation.
 */

#include "am335x-boneblack.dts"
#include "am335x-boneblack-mscc.dtsi"

/ {
	model = "TI AM335x BeagleBone Black for MSCC SPI demo";
	compatible = "ti,am335x-bone-black", "ti,am335x-bone", "ti,am33xx";
};
