// SPDX-License-Identifier: (GPL-2.0+ OR MIT)

&port0 {
	reg = <0>;
	phy-mode = "sgmii";
	phys = <&serdes 0 SERDES6G(0)>;
};

&port1 {
	reg = <1>;
	phy-mode = "sgmii";
	phys = <&serdes 1 SERDES6G(1)>;
};

&port2 {
	reg = <2>;
	phy-mode = "rgmii";
	phys = <&serdes 2 RG(0)>;
};

&port3 {
	reg = <3>;
	phy-mode = "rgmii";
	phys = <&serdes 3 RG(1)>;
};
