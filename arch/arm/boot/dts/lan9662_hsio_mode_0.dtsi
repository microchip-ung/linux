// SPDX-License-Identifier: (GPL-2.0+ OR MIT)

&port0 {
	reg = <0>;
	phy-mode = "qsgmii";
	phys = <&serdes 0 SERDES6G(1)>;
};

&port1 {
	reg = <1>;
	phy-mode = "qsgmii";
	phys = <&serdes 1 SERDES6G(1)>;
};

&port2 {
	reg = <2>;
	phy-mode = "qsgmii";
	phys = <&serdes 2 SERDES6G(1)>;
};

&port3 {
	reg = <3>;
	phy-mode = "qsgmii";
	phys = <&serdes 3 SERDES6G(1)>;
};
