// SPDX-License-Identifier: GPL-2.0
/dts-v1/;
#include "bcm2711-rpi-cm4-pci.dtsi"

#include <dt-bindings/mfd/atmel-flexcom.h>
#include <dt-bindings/clock/microchip,lan966x.h>

&pcie0 {
	pci@1,0 {
		#address-cells = <3>;
		#size-cells = <2>;
		device_type = "pci";

		reg = <0 0 0 0 0>;
		ranges = <0x00000000 0x6 0x00000000  0x02000000 0x0 0xc0000000  0x0 0x40000000>;

		lan969x: switch@1055,9690 {
			compatible = "pci1055,9690";

			reg = <0x0000 0 0 0 0>;
			#address-cells = <1>;
			#size-cells = <1>;

			ranges = <0x00000000 0x0000000 0x6 0x00000000 0x40000000>;

			#interrupt-cells = <1>;
			interrupt-controller;
			interrupt-parent = <&lan969x>;

			uio0: mscc_switch@e0000000 {
				compatible = "microchip,uio_lan969x_irqmux";
				reg = <0x00000000 0x4000000>;

				interrupts = <17 8 9 7 16 15>;
				interrupt-names = "master", "ptp_sync", "ptp_rdy",
						  "oam_vop", "sgpio", "gpio";
			};
		};
	};
};
