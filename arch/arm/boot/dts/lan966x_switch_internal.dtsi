// SPDX-License-Identifier: (GPL-2.0+ OR MIT)
/*
 * lan966x-pcb8290.dts - Device Tree file for LAN966X-PCB8290 board
 *
 * Copyright (C) 2022 Microchip Technology Inc. and its subsidiaries
 *
 * Author: Horatiu Vultur <horatiu.vultur@microchip.com>
 */

#include <dt-bindings/soc/mchp,lan966x_icpu.h>

&switch {
		compatible = "mchp,lan966x-switch";
		reg = <ORG_0_ADDR ORG_0_SIZE>,
		      <SYS_ADDR SYS_SIZE>,
		      <QS_ADDR QS_SIZE>,
		      <QSYS_ADDR QSYS_SIZE>,

		      <ANA_ADDR ANA_SIZE>,
		      <REW_ADDR REW_SIZE>,
		      <GCB_ADDR 0x44>,
		      <PTP_ADDR PTP_SIZE>,

		      <VCAP_0_ADDR VCAP_0_SIZE>,
		      <VCAP_1_ADDR VCAP_1_SIZE>,
		      <VCAP_2_ADDR VCAP_2_SIZE>,
		      <AFI_ADDR AFI_SIZE>,
		      <MEP_ADDR MEP_SIZE>,

		      <CPU_ADDR CPU_SIZE>,
		      <FDMA_ADDR FDMA_SIZE>,
		      <CHIP_TOP_ADDR CHIP_TOP_SIZE>,

		      <DEV_0_ADDR DEV_0_SIZE>,
		      <DEV_1_ADDR DEV_1_SIZE>,
		      <DEV_2_ADDR DEV_2_SIZE>,
		      <DEV_3_ADDR DEV_3_SIZE>,
		      <DEV_4_ADDR DEV_4_SIZE>,
		      <DEV_5_ADDR DEV_5_SIZE>,
		      <DEV_6_ADDR DEV_6_SIZE>,
		      <DEV_7_ADDR DEV_7_SIZE>;

		reg-names = "org", "sys", "qs", "qsys",
			    "ana", "rew", "gcb", "ptp",
			    "es0", "s1", "s2", "afi", "mep",
			    "cpu", "fdma", "chip_top",
			    "port0", "port1", "port2", "port3",
			    "port4", "port5", "port6", "port7";

		interrupts = <GIC_SPI 10 IRQ_TYPE_LEVEL_HIGH
		              GIC_SPI 14 IRQ_TYPE_LEVEL_HIGH
		              GIC_SPI 11 IRQ_TYPE_LEVEL_HIGH
		              GIC_SPI 12 IRQ_TYPE_LEVEL_HIGH
		              GIC_SPI 9 IRQ_TYPE_LEVEL_HIGH>;
		interrupt-names = "ptp-sync", "fdma", "ptp", "xtr", "ana";
};
