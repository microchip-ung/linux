## Documentation/devicetree/bindings/clock/microchip,vcoreiii-servalt-pll.yaml
```yaml
# SPDX-License-Identifier: (GPL-2.0-only OR BSD-2-Clause)
%YAML 1.2
---
$id: http://devicetree.org/schemas/clock/microchip,vcoreiii-servalt-pll.yaml#
$schema: http://devicetree.org/meta-schemas/core.yaml#

title: MIPS VCoreIII Serval-T CPU Base Clock

maintainers:
  - Lars Povlsen <lars.povlsen@microchip.com>

properties:
  compatible:
    items:
      - enum:
          - microchip,vcoreiii-servalt-pll

  "#clock-cells":
    const: 0

  reg:
    maxItems: 1

required:
  - compatible
  - "#clock-cells"
  - reg

additionalProperties: false

examples:
  - |
    dyn_cpu_clk: dyn-cpu-clock {
            compatible = "microchip,vcoreiii-servalt-pll";
            reg = <0x71170000 8>;
            #clock-cells = <0>;
    };
```

## Documentation/devicetree/bindings/mfd/atmel,flexcom.yaml
```yaml
# SPDX-License-Identifier: (GPL-2.0-only OR BSD-2-Clause)
%YAML 1.2
---
$id: http://devicetree.org/schemas/mfd/atmel,flexcom.yaml#
$schema: http://devicetree.org/meta-schemas/core.yaml#

title: Atmel Flexcom (Flexible Serial Communication Unit)

maintainers:
  - Kavyasree Kotagiri <kavyasree.kotagiri@microchip.com>

description:
  The Atmel Flexcom is just a wrapper which embeds a SPI controller,
  an I2C controller and an USART. Only one function can be used at a
  time and is chosen at boot time according to the device tree.

properties:
  compatible:
    enum:
      - atmel,sama5d2-flexcom
      - microchip,lan966x-flexcom

  reg:
    minItems: 1
    maxItems: 2

  clocks:
    maxItems: 1

  "#address-cells":
    const: 1

  "#size-cells":
    const: 1

  ranges:
    description:
      One range for the full I/O register region. (including USART,
      TWI and SPI registers).
    items:
      maxItems: 3

  atmel,flexcom-mode:
    description: |
      Specifies the flexcom mode as follows:
      1: USART
      2: SPI
      3: I2C.
    $ref: /schemas/types.yaml#/definitions/uint32
    enum: [1, 2, 3]

  microchip,flx-shrd-pins:
    description: Specify the Flexcom shared pins to be used for flexcom
      chip-selects.
    $ref: /schemas/types.yaml#/definitions/uint32-array
    minItems: 1
    maxItems: 2
    items:
      minimum: 0
      maximum: 20

  microchip,flx-cs:
    description: Flexcom chip selects. Here, value of '0' represents "cts" line
      of flexcom USART or "cs0" line of flexcom SPI and value of '1' represents
      "rts" line of flexcom USART or "cs1" line of flexcom SPI.
    $ref: /schemas/types.yaml#/definitions/uint32-array
    minItems: 1
    maxItems: 2
    items:
      minimum: 0
      maximum: 1

patternProperties:
  "^serial@[0-9a-f]+$":
    description: See atmel-usart.txt for details of USART bindings.
    type: object

  "^spi@[0-9a-f]+$":
    description: See ../spi/spi_atmel.txt for details of SPI bindings.
    type: object

    properties:
      compatible:
        const: atmel,at91rm9200-spi

  "^i2c@[0-9a-f]+$":
    description: See ../i2c/i2c-at91.txt for details of I2C bindings.
    type: object

required:
  - compatible
  - reg
  - clocks
  - "#address-cells"
  - "#size-cells"
  - ranges
  - atmel,flexcom-mode

allOf:
  - if:
      properties:
        compatible:
          contains:
            const: microchip,lan966x-flexcom

    then:
      properties:
        reg:
          minItems: 2
          maxItems: 2
          items:
            - description: Flexcom base regsiters map
            - description: Flexcom shared registers map
      required:
        - microchip,flx-shrd-pins
        - microchip,flx-cs

additionalProperties: false

examples:
  - |
    #include <dt-bindings/interrupt-controller/arm-gic.h>

    flx0: flexcom@f8034000 {
          compatible = "atmel,sama5d2-flexcom";
          reg = <0xf8034000 0x200>;
          clocks = <&flx0_clk>;
          #address-cells = <1>;
          #size-cells = <1>;
          ranges = <0x0 0xf8034000 0x800>;
          atmel,flexcom-mode = <2>;

          spi0: spi@400 {
                compatible = "atmel,at91rm9200-spi";
                reg = <0x400 0x200>;
                interrupts = <19 IRQ_TYPE_LEVEL_HIGH 7>;
                pinctrl-names = "default";
                pinctrl-0 = <&pinctrl_flx0_default>;
                #address-cells = <1>;
                #size-cells = <0>;
                clocks = <&flx0_clk>;
                clock-names = "spi_clk";
                atmel,fifo-size = <32>;
          };
    };
  - |
    #include <dt-bindings/interrupt-controller/arm-gic.h>

    flx3: flexcom@e0064000 {
          compatible = "microchip,lan966x-flexcom";
          reg = <0xe0064000 0x100>,
                <0xe2004180 0x8>;
          clocks = <&flx0_clk>;
          #address-cells = <1>;
          #size-cells = <1>;
          ranges = <0x0 0xe0040000 0x800>;
          atmel,flexcom-mode = <2>;
          microchip,flx-shrd-pins = <9>;
          microchip,flx-cs = <0>;

          spi3: spi@400 {
                compatible = "atmel,at91rm9200-spi";
                reg = <0x400 0x200>;
                interrupts = <GIC_SPI 51 IRQ_TYPE_LEVEL_HIGH>;
                pinctrl-names = "default";
                pinctrl-0 = <&pinctrl_flx3_default>;
                #address-cells = <1>;
                #size-cells = <0>;
                clocks = <&nic_clk>;
                clock-names = "spi_clk";
                atmel,fifo-size = <32>;
          };
    };
...
```

## Documentation/devicetree/bindings/mux/microchip,sparx5-spi-mux.yaml
```yaml
# SPDX-License-Identifier: (GPL-2.0-only OR BSD-2-Clause)
%YAML 1.2
---
$id: http://devicetree.org/schemas/mux/microchip,sparx5-spi-mux.yaml#
$schema: http://devicetree.org/meta-schemas/core.yaml#

title: Microchip Sparx5 SPI mux

maintainers:
  - Lars Povlsen <lars.povlsen@microchip.com>

description: |
  The Microchip Sparx5 SPI controller has two bus segments. In order
  to switch between the appropriate bus for any given SPI slave
  (defined by a chip select), this mux driver is used. The device tree
  node for the mux will define the bus mapping for any chip
  selects. The default bus mapping for any chip select is "0", such
  that only non-default mappings need to be explicitly defined.

properties:
  compatible:
    enum:
      - microchip,sparx5-spi-mux

  '#address-cells':
    const: 1

  '#size-cells':
    const: 0

  '#mux-control-cells':
    const: 0

required:
  - compatible

additionalProperties: false

patternProperties:
  "^mux@[0-9a-f]$":
    type: object

    properties:
      reg:
        description:
          Chip select to define bus mapping for.
        minimum: 0
        maximum: 15

      microchip,bus-interface:
        description:
          The bus interface to use for this chip select.
        $ref: /schemas/types.yaml#/definitions/uint32
        enum: [0, 1]

    required:
      - reg
      - microchip,bus-interface

examples:
  - |
    mux: mux-controller {
      compatible = "microchip,sparx5-spi-mux";
      #address-cells = <1>;
      #size-cells = <0>;
      #mux-control-cells = <0>;
      mux@e {
        reg = <14>;
        microchip,bus-interface = <1>;
      };
    };
```

## Documentation/devicetree/bindings/net/microchip,lan969x-switch.yaml
```yaml
# SPDX-License-Identifier: GPL-2.0-only OR BSD-2-Clause
%YAML 1.2
---
$id: http://devicetree.org/schemas/net/microchip,lan969x-switch.yaml#
$schema: http://devicetree.org/meta-schemas/core.yaml#

title: Microchip lan969x Ethernet switch controller

maintainers:
  - Daniel Machon  <daniel.machon@microchip.com>

description: |
  The lan969x Enterprise Ethernet switch family provides a rich set of
  Enterprise switching features such as advanced TCAM-based VLAN and
  QoS processing enabling delivery of differentiated services, and
  security through TCAM-based frame processing using versatile content
  aware processor (VCAP).

  IPv4/IPv6 Layer 3 (L3) unicast and multicast routing is supported
  with up to 18K IPv4/9K IPv6 unicast LPM entries and up to 9K IPv4/3K
  IPv6 (S,G) multicast groups.

  L3 security features include source guard and reverse path
  forwarding (uRPF) tasks. Additional L3 features include VRF-Lite and
  IP tunnels (IP over GRE/IP).

  The lan969x switch family targets managed Layer 2 and Layer 3
  equipment in SMB, SME, and Enterprise where high port count
  1G/2.5G/5G/10G switching with 10G/25G aggregation links is required.

properties:
  $nodename:
    pattern: "^switch@[0-9a-f]+$"

  compatible:
    const: microchip,lan969x-switch

  reg:
    items:
      - description: cpu target
      - description: devices target

  reg-names:
    items:
      - const: cpu
      - const: devices

  interrupts:
    minItems: 1
    items:
      - description: register based extraction
      - description: frame dma based extraction
      - description: ptp interrupt

  interrupt-names:
    minItems: 1
    items:
      - const: xtr
      - const: fdma
      - const: ptp

  resets:
    items:
      - description: Reset controller used for switch core reset (soft reset)

  reset-names:
    items:
      - const: switch

  mac-address: true

  ethernet-ports:
    type: object
    additionalProperties: false

    properties:
      '#address-cells':
        const: 1
      '#size-cells':
        const: 0

    patternProperties:
      "^port@[0-9a-f]+$":
        $ref: /schemas/net/ethernet-controller.yaml#
        unevaluatedProperties: false

        properties:
          reg:
            description: Switch port number

          phys:
            maxItems: 1
            description:
              phandle of a Ethernet SerDes PHY.  This defines which SerDes
              instance will handle the Ethernet traffic.

          microchip,bandwidth:
            description: Specifies bandwidth in Mbit/s allocated to the port.
            $ref: "/schemas/types.yaml#/definitions/uint32"
            maximum: 10000

          microchip,sd-sgpio:
            description:
              Index of the ports Signal Detect SGPIO in the set of 384 SGPIOs
              This is optional, and only needed if the default used index is
              is not correct.
            $ref: "/schemas/types.yaml#/definitions/uint32"
            minimum: 0
            maximum: 383

        required:
          - reg
          - phy-mode
          - microchip,bandwidth

        oneOf:
          - required:
              - phy-handle
          - required:
              - sfp
              - managed

required:
  - compatible
  - reg
  - reg-names
  - interrupts
  - interrupt-names
  - ethernet-ports

additionalProperties: false

examples:
  - |
    #include <dt-bindings/interrupt-controller/arm-gic.h>

    switch: switch@e0000000 {
        compatible = "microchip,lan969x-switch";
        reg = <0xe00c0000 0x0010000>,
            <0xe2010000 0x13f0000>;
        reg-names = "cpu", "devices";
        interrupt-names = "xtr", "fdma", "ptp";
        interrupts = <GIC_SPI 10 IRQ_TYPE_LEVEL_HIGH>,
            <GIC_SPI 88 IRQ_TYPE_LEVEL_HIGH>,
            <GIC_SPI  8 IRQ_TYPE_LEVEL_HIGH>;
        resets = <&reset 0>;
        reset-names = "switch";
        status = "okay";
        ethernet-ports {
            #address-cells = <1>;
            #size-cells = <0>;

            port0: port@0 {
                 reg = <0>;
                 microchip,bandwidth = <1000>;
                 phy-handle = <&phy4>;
                 phy-mode = "qsgmii";
                 phys = <&serdes 0>;
            };

            port1: port@1 {
                 reg = <1>;
                 microchip,bandwidth = <1000>;
                 phy-handle = <&phy5>;
                 phy-mode = "qsgmii";
                 phys = <&serdes 0>;
            };

            port2: port@2 {
                 reg = <2>;
                 microchip,bandwidth = <1000>;
                 phy-handle = <&phy6>;
                 phy-mode = "qsgmii";
                 phys = <&serdes 0>;
            };

            port3: port@3 {
                 reg = <3>;
                 microchip,bandwidth = <1000>;
                 phy-handle = <&phy7>;
                 phy-mode = "qsgmii";
                 phys = <&serdes 0>;
            };

            port4: port@4 {
                 reg = <4>;
                 microchip,bandwidth = <1000>;
                 phy-handle = <&phy8>;
                 phy-mode = "qsgmii";
                 phys = <&serdes 1>;
            };

            port5: port@5 {
                 reg = <5>;
                 microchip,bandwidth = <1000>;
                 phy-handle = <&phy9>;
                 phy-mode = "qsgmii";
                 phys = <&serdes 1>;
            };

            port6: port@6 {
                 reg = <6>;
                 microchip,bandwidth = <1000>;
                 phy-handle = <&phy10>;
                 phy-mode = "qsgmii";
                 phys = <&serdes 1>;
            };

            port7: port@7 {
                 reg = <7>;
                 microchip,bandwidth = <1000>;
                 phy-handle = <&phy11>;
                 phy-mode = "qsgmii";
                 phys = <&serdes 1>;
            };

            port24: port@24 {
                  reg = <24>;
                  microchip,bandwidth = <10000>;
                  phys = <&serdes 6>;
                  phy-mode = "10gbase-r";
                  sfp = <&sfp0>;
                  microchip,sd-sgpio = <365>;
                  managed = "in-band-status";
            };

            port25: port@25 {
                  reg = <25>;
                  microchip,bandwidth = <10000>;
                  phys = <&serdes 7>;
                  phy-mode = "10gbase-r";
                  sfp = <&sfp1>;
                  microchip,sd-sgpio = <369>;
                  managed = "in-band-status";
            };

            port28: port@28 {
                  reg = <28>;
                  microchip,bandwidth = <1000>;
                  phy-handle = <&phy3>;
                  phy-mode = "rgmii";
            };
        };
    };

...
#  vim: set ts=2 sw=2 sts=2 tw=80 et cc=80 ft=yaml :
```
