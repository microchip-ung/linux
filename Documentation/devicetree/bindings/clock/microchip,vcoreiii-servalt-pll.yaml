## drivers/net/ethernet/microchip/sparx5/Kconfig
```kconfig
# SPDX-License-Identifier: GPL-2.0-only
#
# Microchip network device configuration
#

config SPARX5_SWITCH
	tristate "Sparx5 switch driver"
	depends on NET_SWITCHDEV
	depends on HAS_IOMEM
	depends on OF
	depends on ARCH_SPARX5 || ARCH_LAN969X || COMPILE_TEST
	depends on PTP_1588_CLOCK_OPTIONAL
	depends on BRIDGE || BRIDGE=n
	select PHYLINK
	select PHY_SPARX5_SERDES
	select RESET_CONTROLLER
	select VCAP
	help
	  This driver supports the Sparx5 network switch device.

config SPARX5_DEBUG
	bool "Sparx5 Switch debugging"
	depends on SPARX5_SWITCH
	help
	  Sparx5 Switch debugging,

	  This adds VCAP and TC command debugging to the runtime.

	  Do not enable this, unless you are debugging the driver.

config LAN969X_SWITCH_APPL
	tristate "Lan969x switch driver used by APPL"
	help
	  This driver supports the Lan969x network switch device for APPL.

config LAN969X_SWITCH
	tristate "Lan969x switch driver"
	select SPARX5_SWITCH
	help
	  This driver supports the lan969x network switch device.
```

## drivers/net/ethernet/microchip/vcap/Kconfig
```kconfig
# SPDX-License-Identifier: GPL-2.0-only
#
# Microchip VCAP API configuration
#

if NET_VENDOR_MICROCHIP

config VCAP
	bool "VCAP (Versatile Content-Aware Processor) library"
	help
	  Provides the basic VCAP functionality for multiple Microchip switchcores

config VCAP_KUNIT_TEST
	tristate "KUnit test for VCAP library" if !KUNIT_ALL_TESTS
	depends on KUNIT
	select VCAP
	default KUNIT_ALL_TESTS
	help
	  This builds unit tests for the VCAP library.

	  For more information on KUnit and unit tests in general, please refer
	  to the KUnit documentation in Documentation/dev-tools/kunit/.

	  If unsure, say N.

endif # NET_VENDOR_MICROCHIP
```

## drivers/net/ethernet/vitesse/Kconfig
```kconfig
#  Copyright (c) 2015 Microsemi Corporation
#
#  Permission is hereby granted, free of charge, to any person obtaining a copy
#  of this software and associated documentation files (the "Software"), to deal
#  in the Software without restriction, including without limitation the rights
#  to use, copy, modify, merge, publish, distribute, sublicense, and/or sell
#  copies of the Software, and to permit persons to whom the Software is
#  furnished to do so, subject to the following conditions:
#
#  The above copyright notice and this permission notice shall be included in
#  all copies or substantial portions of the Software.
#
#  THE SOFTWARE IS PROVIDED "AS IS", WITHOUT WARRANTY OF ANY KIND, EXPRESS OR
#  IMPLIED, INCLUDING BUT NOT LIMITED TO THE WARRANTIES OF MERCHANTABILITY,
#  FITNESS FOR A PARTICULAR PURPOSE AND NONINFRINGEMENT.  IN NO EVENT SHALL THE
#  AUTHORS OR COPYRIGHT HOLDERS BE LIABLE FOR ANY CLAIM, DAMAGES OR OTHER
#  LIABILITY, WHETHER IN AN ACTION OF CONTRACT, TORT OR OTHERWISE, ARISING FROM,
#  OUT OF OR IN CONNECTION WITH THE SOFTWARE OR THE USE OR OTHER DEALINGS IN
#  THE SOFTWARE.


#
# Vitesse device configuration
#

config NET_VENDOR_VITESSE
	bool "Vitesse devices"
	default y
	help
	  This enables network interfaces from Vitesse Semiconductor

if NET_VENDOR_VITESSE

config VC3FDMA
	tristate "VCore-III Gigabit Ethernet support"
#	depends on VTSS_VCOREIII_ARCH
	help
	  This driver use the VCore-III switch FDMA
          to implement a network interface.

	  To compile this driver as a module, choose M here: the
	  module will be called vc3fdma.

config VC3MUX
	tristate "VCore-III IFH Frame VLAN MUX support"
	default y
	help
	  This driver multiplex frames received with Vitess IFH encapulation into respective
          network vlan interfaces.

config DYING_GASP
	tristate "VCore-III Dying Gasp support"
	default n
	help
	  This driver creates a user defined buffer for dying gasp


endif # NET_VENDOR_VITESSE
```
